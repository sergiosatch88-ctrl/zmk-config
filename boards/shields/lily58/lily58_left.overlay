#include "lily58.dtsi"

&kscan0 {
    col-gpios
        = <&pro_micro 19 GPIO_ACTIVE_HIGH>
        , <&pro_micro 18 GPIO_ACTIVE_HIGH>
        , <&pro_micro 15 GPIO_ACTIVE_HIGH>
        , <&pro_micro 14 GPIO_ACTIVE_HIGH>
        , <&pro_micro 16 GPIO_ACTIVE_HIGH>
        , <&pro_micro 10 GPIO_ACTIVE_HIGH>
        ;
};

 / {
    encoders {
        compatible = "zmk,encoders";

        encoder_left: encoder_left {
            label = "ENCODER_LEFT";
            gpios = <&gpio0 20 GPIO_ACTIVE_HIGH>,
                    <&gpio0 21 GPIO_ACTIVE_HIGH>;
            steps = <4>;
        };
    };
};
